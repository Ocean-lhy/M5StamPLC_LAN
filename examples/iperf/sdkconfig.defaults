## examples/iperf/sdkconfig.defaults
```kconfig
# Increase main task stack size
CONFIG_ESP_MAIN_TASK_STACK_SIZE=7168

# Enable filesystem for console commands history storage
CONFIG_ESPTOOLPY_FLASHSIZE_4MB=y
CONFIG_PARTITION_TABLE_CUSTOM=y
CONFIG_PARTITION_TABLE_CUSTOM_FILENAME="partitions_example.csv"
CONFIG_PARTITION_TABLE_FILENAME="partitions_example.csv"

# Enable FreeRTOS stats formatting functions, needed for 'tasks' command
CONFIG_FREERTOS_USE_TRACE_FACILITY=y
CONFIG_FREERTOS_USE_STATS_FORMATTING_FUNCTIONS=y

# --------------------------------
# Performance optimization options
# --------------------------------
# `lwIP` and `iperf` tasks have serial dependency to each other (i.e. `iperf` must wait for `lwIP`
# to process the packets). Therefore, you don't gain much performance improvement when running
# multi core mode. On the other hand, IRAM optimizations have greater effect for single core mode.

# Run FreeRTOS only on the first core
CONFIG_FREERTOS_UNICORE=y

# Disable watch dog
CONFIG_ESP_INT_WDT=n
CONFIG_ESP_TASK_WDT_EN=n

# Enable lwIP IRAM optimization
CONFIG_LWIP_IRAM_OPTIMIZATION=y

# Enable Ethernet IRAM optimization
CONFIG_ETH_IRAM_OPTIMIZATION=y

CONFIG_EXAMPLE_USE_SPI_ETHERNET=y
CONFIG_EXAMPLE_USE_INTERNAL_ETHERNET=n
CONFIG_EXAMPLE_SPI_ETHERNETS_NUM=1
CONFIG_EXAMPLE_USE_W5500=y
CONFIG_EXAMPLE_ETH_SPI_CLOCK_MHZ=40
CONFIG_EXAMPLE_ETH_SPI_SCLK_GPIO=7
CONFIG_EXAMPLE_ETH_SPI_MOSI_GPIO=8
CONFIG_EXAMPLE_ETH_SPI_MISO_GPIO=9
CONFIG_EXAMPLE_ETH_SPI_CS0_GPIO=11
CONFIG_EXAMPLE_ETH_SPI_INT0_GPIO=14
CONFIG_EXAMPLE_ETH_SPI_PHY_RST0_GPIO=3

CONFIG_ESP_DEFAULT_CPU_FREQ_MHZ_240=y

CONFIG_ESP_CONSOLE_USB_SERIAL_JTAG=y
```

## sdkconfig.defaults
```kconfig
# ESP32-S3 is the host SoC on ESP-Thread-Border-Router board
CONFIG_IDF_TARGET="esp32s3"

#
# Serial flasher config
#
CONFIG_ESPTOOLPY_FLASHSIZE_8MB=y
CONFIG_ESPTOOLPY_FLASHMODE_QIO=y
# end of Serial flasher config

#
# Partition Table
#
CONFIG_PARTITION_TABLE_CUSTOM=y
CONFIG_PARTITION_TABLE_CUSTOM_FILENAME="partitions.csv"
CONFIG_PARTITION_TABLE_FILENAME="partitions.csv"
CONFIG_PARTITION_TABLE_OFFSET=0x8000
CONFIG_PARTITION_TABLE_MD5=y
# end of Partition Table

#
# Compiler options
#
CONFIG_COMPILER_OPTIMIZATION_SIZE=y

#
# ESP System Settings
#
CONFIG_ESP_SYSTEM_EVENT_TASK_STACK_SIZE=3584
#CONFIG_ESP_DEFAULT_CPU_FREQ_MHZ_240=y
# end of ESP System Settings

#
# Ethernet Configuration
#
CONFIG_ETHERNET_SPI_SUPPORT=y
CONFIG_EXAMPLE_USE_INTERNAL_ETHERNET=n
CONFIG_EXAMPLE_SPI_ETHERNETS_NUM=1
CONFIG_ETHERNET_SPI_SCLK_GPIO=7
CONFIG_ETHERNET_SPI_MOSI_GPIO=8
CONFIG_ETHERNET_SPI_MISO_GPIO=9
CONFIG_ETHERNET_SPI_CLOCK_MHZ=40
CONFIG_ETHERNET_SPI_CS0_GPIO=11
CONFIG_ETHERNET_SPI_INT0_GPIO=14
CONFIG_ETHERNET_SPI_PHY_RST0_GPIO=3


CONFIG_EXAMPLE_USE_SPI_ETHERNET=y

CONFIG_EXAMPLE_ETH_SPI_SCLK_GPIO=7
CONFIG_EXAMPLE_ETH_SPI_MOSI_GPIO=8
CONFIG_EXAMPLE_ETH_SPI_MISO_GPIO=9
CONFIG_EXAMPLE_ETH_SPI_CLOCK_MHZ=40
CONFIG_EXAMPLE_ETH_SPI_CS0_GPIO=11
CONFIG_EXAMPLE_ETH_SPI_INT0_GPIO=14
CONFIG_EXAMPLE_ETH_SPI_PHY_RST0_GPIO=3

# end of Ethernet Configuration

# Enable FreeRTOS stats formatting functions, needed for 'tasks' command
#CONFIG_FREERTOS_USE_TRACE_FACILITY=y
#CONFIG_FREERTOS_USE_STATS_FORMATTING_FUNCTIONS=y

# Run FreeRTOS only on the first core
#CONFIG_FREERTOS_UNICORE=y

# Disable watch dog
#CONFIG_ESP_INT_WDT=n
#CONFIG_ESP_TASK_WDT_EN=n

# Enable lwIP IRAM optimization
#CONFIG_LWIP_IRAM_OPTIMIZATION=y

# Enable Ethernet IRAM optimization
#CONFIG_ETH_IRAM_OPTIMIZATION=y
```
